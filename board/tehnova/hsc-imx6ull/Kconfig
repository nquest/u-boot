## board/tehnova/hsc-imx6ull/Kconfig
```kconfig
if TARGET_MX6ULL_HSC_TEHNOVA

config SYS_BOARD
	default "hsc-imx6ull"

config SYS_VENDOR
	default "tehnova"

config SYS_CONFIG_NAME
	default "hsc-imx6ull"

config IMX_CONFIG
	default "board/tehnova/hsc-imx6ull/imximage.cfg"

endif
```

## board/wirelessroad/mx6ull_wr_netsom/Kconfig
```kconfig
if TARGET_MX6ULL_WR_NETSOM

config SYS_BOARD
	default "mx6ull_wr_netsom"

config SYS_VENDOR
	default "wirelessroad"

config SYS_CONFIG_NAME
	default "mx6ull_wr_netsom"

config IMX_CONFIG
	default "board/wireslessroad/mx6ull_wr_netsom/imximage.cfg"

endif
```

## configs/atol_strike_defconfig
```kconfig
CONFIG_ARM=y
CONFIG_ARCH_SUNXI=y
CONFIG_DEFAULT_DEVICE_TREE="sun50i-a64-atol-strike"
CONFIG_SPL=y
CONFIG_MACH_SUN50I=y
CONFIG_MACPWR="PD14"
CONFIG_RESERVE_ALLWINNER_BOOT0_HEADER=y
CONFIG_MMC_SUNXI_SLOT_EXTRA=2
CONFIG_SUPPORT_EMMC_BOOT=y
CONFIG_SPL_SPI_SUNXI=y
# CONFIG_SYS_MALLOC_CLEAR_ON_INIT is not set
CONFIG_SUN8I_EMAC=y
CONFIG_PHY_REALTEK=y
CONFIG_SPI=y
CONFIG_USB_EHCI_HCD=y
CONFIG_USB_OHCI_HCD=y
```

## configs/mangopi-r_defconfig
```kconfig
CONFIG_ARM=y
CONFIG_ARCH_SUNXI=y
CONFIG_DEFAULT_DEVICE_TREE="sun8i-t113-mangopi-mq-r"
CONFIG_SPL_TEXT_BASE=0x20060
CONFIG_SPL=y
CONFIG_MACH_SUN8I_T113=y
CONFIG_MMC0_CD_PIN="PF6"
# CONFIG_VIDEO_SUNXI is not set
CONFIG_SPL_SPI_SUNXI=y
# CONFIG_SYS_MALLOC_CLEAR_ON_INIT is not set
# CONFIG_AUTOBOOT is not set
CONFIG_PREBOOT=""
# CONFIG_SYS_DEVICE_NULLDEV is not set
CONFIG_LOG_MAX_LEVEL=9
CONFIG_LOG_DEFAULT_LEVEL=6
CONFIG_CMD_CLK=y
CONFIG_CMD_I2C=y
CONFIG_CMD_SDRAM=y
CONFIG_CMD_SPI=y
CONFIG_CMD_LOG=y
# CONFIG_CLK_SUN6I_A31_R is not set
CONFIG_MTD=y
CONFIG_DM_MTD=y
CONFIG_SYS_MTDPARTS_RUNTIME=y
CONFIG_SPI_FLASH_BAR=y
CONFIG_SPI_FLASH_WINBOND=y
CONFIG_SPI_FLASH_MTD=y
CONFIG_PHY_MICREL=y
CONFIG_PHY_MICREL_KSZ8XXX=y
CONFIG_PHY_MSCC=y
CONFIG_PHY_REALTEK=y
CONFIG_PHY_SMSC=y
CONFIG_DM_ETH_PHY=y
CONFIG_SUN8I_EMAC=y
CONFIG_PHY_SUN4I_USB=y
CONFIG_CONS_INDEX=4
CONFIG_SPI=y
CONFIG_USB_EHCI_HCD=y
CONFIG_USB_OHCI_HCD=y
CONFIG_USB_MUSB_HOST=y
# CONFIG_USB_GADGET is not set
# CONFIG_EFI_LOADER is not set
```

## configs/mx6ull_wr_netsom_defconfig
```kconfig
CONFIG_ARM=y
CONFIG_ARCH_MX6=y
CONFIG_SYS_TEXT_BASE=0x87800000
CONFIG_IMX_CONFIG="board/wirelessroad/mx6ull_wr_netsom/imximage.cfg"
CONFIG_MX6ULL=y
CONFIG_TARGET_MX6ULL_WR_NETSOM=y
CONFIG_DEFAULT_DEVICE_TREE="imx6ull-wr-netsom"
CONFIG_SYS_PROMPT="WR2022=> "
# CONFIG_BOOTM_NETBSD is not set
# CONFIG_BOOTM_PLAN9 is not set
# CONFIG_BOOTM_RTEMS is not set
# CONFIG_BOOTM_VXWORKS is not set
# CONFIG_CMD_BOOTEFI is not set
CONFIG_CMD_DM=y
CONFIG_CMD_GPIO=y
CONFIG_CMD_MMC=y
CONFIG_CMD_PART=y
CONFIG_CMD_DHCP=y
# CONFIG_BOOTP_HOSTNAME is not set
# CONFIG_CMD_NFS is not set
CONFIG_CMD_MII=y
CONFIG_CMD_PING=y
CONFIG_OF_CONTROL=y
# CONFIG_ENV_IS_NOWHERE is not set
CONFIG_NET_RANDOM_ETHADDR=y
CONFIG_GPIO_HOG=y
# CONFIG_I2C is not set
CONFIG_FSL_USDHC=y
CONFIG_SF_DEFAULT_BUS=3
CONFIG_SF_DEFAULT_SPEED=20000000
CONFIG_SPI_FLASH_BAR=y
CONFIG_SPI_FLASH_GIGADEVICE=y
CONFIG_SPI_FLASH_MACRONIX=y
CONFIG_SPI_FLASH_WINBOND=y
# CONFIG_SPI_FLASH_USE_4K_SECTORS is not set
CONFIG_PHYLIB=y
CONFIG_PHY_MICREL=y
CONFIG_PHY_MICREL_KSZ8XXX=y
CONFIG_PHY_SMSC=y
CONFIG_DM_MDIO=y
CONFIG_FEC_MXC_SHARE_MDIO=y
CONFIG_FEC_MXC_MDIO_BASE=0x02188000
CONFIG_FEC_MXC=y
CONFIG_MII=y
CONFIG_PINCTRL=y
CONFIG_PINCTRL_IMX6=y
CONFIG_MXC_UART=y
CONFIG_SPI=y
CONFIG_MXC_SPI=y
# CONFIG_CMD_BOOTEFI_BOOTMGR is not set
```
